## boards/shields/pandawings-i/Kconfig.defconfig
```kconfig
if SHIELD_PANDAWINGS_I_LEFT

config ZMK_KEYBOARD_NAME
    # Name must be less than 16 chars long (bluetooth spec)
    default "PandaWings I"

config ZMK_SPLIT_ROLE_CENTRAL
    default y

config ZMK_SPLIT_BLE_CENTRAL_BATTERY_LEVEL_FETCHING
    default y

config ZMK_SPLIT_BLE_CENTRAL_BATTERY_LEVEL_PROXY
    default y

config ZMK_USB
    default y

config ZMK_USB_BOOT
    default y

endif # SHIELD_PANDAWINGS_I_LEFT

# ==============================================================

if SHIELD_PANDAWINGS_I_LEFT || SHIELD_PANDAWINGS_I_RIGHT

config ZMK_SPLIT
    default y

endif # SHIELD_PANDAWINGS_I_LEFT || SHIELD_PANDAWINGS_I_RIGHT
```

## boards/shields/pandawings-i/Kconfig.shield
```kconfig
config SHIELD_PANDAWINGS_I_LEFT
    def_bool $(shields_list_contains,pandawings-i_left)

config SHIELD_PANDAWINGS_I_RIGHT
    def_bool $(shields_list_contains,pandawings-i_right)
```

## boards/shields/pandawings_i/Kconfig.defconfig
```kconfig
if SHIELD_PANDAWINGS_I_LEFT

config ZMK_KEYBOARD_NAME
    default "PandaWings I"

config ZMK_SPLIT_ROLE_CENTRAL
    default y

endif # SHIELD_PANDAWINGS_I_LEFT

if SHIELD_PANDAWINGS_I_LEFT || SHIELD_PANDAWINGS_I_RIGHT

config ZMK_SPLIT
    default y

endif # SHIELD_PANDAWINGS_I_LEFT || SHIELD_PANDAWINGS_I_RIGHT
```

## config/west.yml
```yaml
manifest:
  defaults:
    revision: v0.3 # pin all the imports to v0.3

  remotes:
    - name: zmkfirmware
      url-base: https://github.com/zmkfirmware
    # Additional modules containing boards/shields/custom code can be listed here as well
    # See https://docs.zephyrproject.org/3.2.0/develop/west/manifest.html#projects
  #    - name: joelspadin
  #      url-base: https://github.com/joelspadin

  projects:
    - name: zmk
      remote: zmkfirmware
      revision: v0.3
      import: app/west.yml

    # ZMK modules
  #    - name: zmk-locales
  #      remote: joelspadin
  #      revision: main

  self:
    path: config
```
